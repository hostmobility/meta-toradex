## conf/machine/apalis-t30.conf
```bitbake
#@TYPE: Machine
#@NAME: apalis_t30
#@DESCRIPTION: Toradex Apalis T30

SOC_FAMILY = "tegra:tegra3"
require conf/machine/include/soc-family.inc

PREFERRED_PROVIDER_virtual/kernel = "linux-toradex"

KERNEL_IMAGETYPE = "uImage"
UBOOT_MACHINE = "apalis_t30_config"
UBOOT_ENTRYPOINT = "0x82008000"
UBOOT_LOADADDRESS = "${UBOOT_ENTRYPOINT}"
KEEPUIMAGE = ""

PREFERRED_PROVIDER_virtual/xserver = "xserver-xorg"
PREFERRED_VERSION_xserver-xorg_apalis-t30 = "1.14.0"
XSERVER = "xserver-xorg \
           xf86-input-evdev \
           xf86-input-mouse \
           xf86-video-fbdev \
           xf86-input-keyboard"
# Only has DVI connector for external screen, name is changing to MACHINE_GUI_CLASS
GUI_MACHINE_CLASS = "bigscreen"
MACHINE_GUI_CLASS = "bigscreen"

PREFERRED_PROVIDER_lxde-icon-theme_apalis-t30 = "lxde-icon-theme"
PREFERRED_PROVIDER_lxsession-lite_apalis-t30 = "lxsession"
PREFERRED_PROVIDER_virtual/psplash = "psplash-angstrom"
PREFERRED_PROVIDER_psplash-support = "psplash-angstrom"

MACHINE_FEATURES = "kernel26 screen usbgadget usbhost vfat ext2 alsa touchscreen ethernet"
EXTRA_IMAGEDEPENDS += "u-boot"

# used by sysvinit_2
SERIAL_CONSOLE = "115200 ttyS0"
IMAGE_FSTYPES ?= "tar.bz2"

DEFAULTTUNE = "armv7ahf-neon"
require conf/machine/include/tune-cortexa9.inc
```

## conf/machine/colibri-t30.conf
```bitbake
#@TYPE: Machine
#@NAME: colibri_t30
#@DESCRIPTION: Toradex Colibri T30

SOC_FAMILY = "tegra:tegra3"
require conf/machine/include/soc-family.inc

PREFERRED_PROVIDER_virtual/kernel = "linux-toradex"

KERNEL_IMAGETYPE = "uImage"
UBOOT_MACHINE = "colibri_t30_config"
UBOOT_ENTRYPOINT = "0x82008000"
UBOOT_LOADADDRESS = "${UBOOT_ENTRYPOINT}"
KEEPUIMAGE = ""

PREFERRED_PROVIDER_virtual/xserver = "xserver-xorg"
PREFERRED_VERSION_xserver-xorg_colibri-t30 = "1.13.1"
XSERVER = "xserver-xorg \
           xf86-input-evdev \
           xf86-input-mouse \
           xf86-video-fbdev \
           xf86-input-keyboard"
# Only has DVI connector for external screen, name is changing to MACHINE_GUI_CLASS
GUI_MACHINE_CLASS = "bigscreen"
MACHINE_GUI_CLASS = "bigscreen"

PREFERRED_PROVIDER_lxde-icon-theme_colibri-t30 = "lxde-icon-theme"
PREFERRED_PROVIDER_lxsession-lite_colibri-t30 = "lxsession"
PREFERRED_PROVIDER_virtual/psplash = "psplash-angstrom"
PREFERRED_PROVIDER_psplash-support = "psplash-angstrom"

MACHINE_FEATURES = "kernel26 screen usbgadget usbhost vfat ext2 alsa touchscreen ethernet wifi bluetooth 3g"
EXTRA_IMAGEDEPENDS += "u-boot"

# used by sysvinit_2
SERIAL_CONSOLE = "115200 ttyS0"
IMAGE_FSTYPES ?= "tar.bz2"

# T20 does not have neon, so at the moment we also do not compile for neon on T30
DEFAULTTUNE = "armv7ahf"
#choose a specific vfp, or we end up with the default vfpv2 optimization
TUNE_CCARGS += "-mfpu=vfpv3-d16"
require conf/machine/include/tune-cortexa9.inc
```
